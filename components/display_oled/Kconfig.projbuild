## components/display_oled/Kconfig.projbuild
```kconfig
menu "OLED Display (SH1106)"

    config IAQ_OLED_ENABLE
        bool "Enable OLED display"
        default y
        help
            Enable the SH1106-based OLED display. Uses the shared I2C bus
            (see Sensor Hardware Configuration → I2C Bus Configuration).

    config IAQ_OLED_I2C_ADDR
        int "OLED I2C address"
        default 60  # 0x3C
        range 8 119
        depends on IAQ_OLED_ENABLE
        help
            7-bit I2C address for the OLED controller. Most SH1106/SSD1306 modules
            are at 0x3C (60) or 0x3D (61).

    config IAQ_OLED_COLUMN_OFFSET
        int "Column offset for 132-wide modules"
        default 2
        range 0 4
        depends on IAQ_OLED_ENABLE
        help
            SH1106 has 132 columns with typically only 128 visible. Set the left
            column offset (0–4) so the 128-pixel content is centered.

    choice IAQ_OLED_ROTATION
        prompt "Rotation"
        default IAQ_OLED_ROTATION_0
        depends on IAQ_OLED_ENABLE
        help
            Rotate the display 0 or 180 degrees.

        config IAQ_OLED_ROTATION_0
            bool "0°"

        config IAQ_OLED_ROTATION_180
            bool "180°"
    endchoice

    config IAQ_OLED_CONTRAST
        int "Contrast (0-255)"
        default 96
        range 0 255
        depends on IAQ_OLED_ENABLE
        help
            SH1106 contrast (0x81 command). Typical: 96–160.

    config IAQ_OLED_REFRESH_MS
        int "Refresh interval (ms)"
        default 500
        range 100 5000
        depends on IAQ_OLED_ENABLE
        help
            UI refresh cadence for dynamic screens.

    config IAQ_OLED_IDLE_TIMEOUT_MS
        int "Idle auto-off timeout (ms)"
        default 60000
        range 0 3600000
        depends on IAQ_OLED_ENABLE
        help
            Turns off the display after inactivity. 0 disables auto-off.

    menu "Night Schedule"
        depends on IAQ_OLED_ENABLE

        config IAQ_OLED_NIGHT_START_H
            int "Night start hour (0-23)"
            default 23
            range 0 23
        config IAQ_OLED_NIGHT_END_H
            int "Night end hour (0-23)"
            default 7
            range 0 23
        config IAQ_OLED_WAKE_SECS
            int "Night wake duration (s)"
            default 15
            range 5 600
            help
                When in night mode, a button press will wake the display for this duration.
    endmenu

    menu "Button"
        depends on IAQ_OLED_ENABLE

        config IAQ_OLED_BUTTON_GPIO
            int "Button GPIO (-1 to disable)"
            default -1
            range -1 48
        config IAQ_OLED_BUTTON_ACTIVE_LOW
            bool "Button is active low"
            default y
        config IAQ_OLED_BUTTON_DEBOUNCE_MS
            int "Debounce (ms)"
            default 30
            range 1 200
        config IAQ_OLED_BUTTON_LONG_MS
            int "Long-press threshold (ms)"
            default 1200
            range 100 10000
    endmenu

endmenu
```

## components/sensor_coordinator/Kconfig.projbuild
```kconfig
menu "Sensor Coordinator"

config IAQ_CADENCE_MCU_MS
    int "MCU temperature cadence (ms)"
    default 10000
    range 0 600000
    help
        Period between MCU internal temperature sensor reads.
        Recommended: 10s. MCU temperature changes slowly; shorter cadences
        mostly add noise. Set 0 to disable.

config IAQ_CADENCE_SHT45_MS
    int "SHT45 cadence (ms)"
    default 2000
    range 0 600000
    help
        Period between SHT45 reads. Recommended: 2s.
        Faster than ~2s offers little benefit and can increase self-heating.
        Set 0 to disable.

config IAQ_CADENCE_BMP280_MS
    int "BMP280 cadence (ms)"
    default 10000
    range 0 600000
    help
        Period between BMP280 reads. Recommended: 10s.
        Pressure changes slowly; shorter cadences add noise without value.
        Set 0 to disable.

config IAQ_CADENCE_SGP41_MS
    int "SGP41 cadence (ms)"
    default 1000
    range 0 600000
    help
        Period between SGP41 reads. Recommended: 1s (or 10s).
        Sensirion's Gas Index Algorithm is validated at 1s and 10s sampling.
        The driver initializes the algorithm using this cadence. Set 0 to disable.

config IAQ_CADENCE_PMS5003_MS
    int "PMS5003 cadence (ms)"
    default 10000
    range 0 600000
    help
        Period between PMS5003 reads. Recommended: 10–30s.
        Continuous fast sampling increases fan wear and dust accumulation;
        10s is a good balance for responsiveness. Set 0 to disable.

config IAQ_CADENCE_S8_MS
    int "Senseair S8 cadence (ms)"
    default 10000
    range 0 600000
    help
        Period between S8 CO2 reads. Recommended: 10s.
        CO2 dynamics are slow (T90 ~30s); faster sampling rarely adds value.
        Set 0 to disable.

menu "Sensor Warm-up Durations"

    config IAQ_WARMUP_MCU_MS
        int "MCU temperature warm-up (ms)"
        default 0
        range 0 60000
        help
            MCU sensor warm-up time. Reads are blocked until this period elapses.
            Default: 0 (no warm-up needed).

config IAQ_WARMUP_SHT45_MS
        int "SHT45 warm-up (ms)"
        default 0
        range 0 60000
        help
            SHT45 warm-up time after power-on.
            Default: 0 (ready immediately).

    config IAQ_WARMUP_BMP280_MS
        int "BMP280 warm-up (ms)"
        default 20000
        range 0 60000
        help
            BMP280 warm-up time after power-on.
            Default: 0 (ready immediately).

    config IAQ_WARMUP_SGP41_MS
        int "SGP41 warm-up (ms)"
        default 55000
        range 10000 60000
        help
            SGP41 VOC/NOx sensor warm-up duration. The sensor requires:
            - Minimum 10s: Mandatory conditioning period (hardware requirement)
            - Recommended 55s: Full stabilization (10s conditioning + 45s algorithm blackout)

            After 10s conditioning, the sensor outputs readings, but the gas index
            algorithm needs ~45s more to report accurate values. Setting this to 10s
            will make the sensor available faster, but initial readings may be unstable.
            Default: 55000ms (55 seconds) for accurate readings from the start.

    config IAQ_WARMUP_PMS5003_MS
        int "PMS5003 warm-up (ms)"
        default 30000
        range 0 60000
        help
            PMS5003 particulate sensor needs ~30s to stabilize fan and readings.
            Default: 30000 (30 seconds).

    config IAQ_WARMUP_S8_MS
        int "Senseair S8 warm-up (ms)"
        default 20000
        range 0 60000
        help
            S8 CO2 sensor requires ~20s warm-up for accurate readings.
            Default: 20000 (20 seconds).

endmenu

config IAQ_SIMULATION
    bool "Enable sensor simulation mode"
    default n
    help
        Replace real sensor reads with simulated data.
        Useful for testing MQTT/HA integration without hardware.
        Simulation still respects cadences, warm-up delays, and state machine logic.

menu "Sensor Fusion"
    config FUSION_PM_RH_ENABLE
        bool "Enable PM humidity compensation"
        default y
        help
            Correct PM2.5/PM10 readings for humidity effects.
            Optical PM sensors over-read at high RH due to hygroscopic growth.
            Applies correction: pm_dry = pm_raw / (1 + a*(RH/100)^b)

    config FUSION_PM_RH_A
        string "PM RH correction coefficient A"
        default "0.3"
        depends on FUSION_PM_RH_ENABLE
        help
            Coefficient 'a' in PM RH correction formula.
            Default: 0.3 (conservative, based on literature).
            Tune via console 'fusion set pm_offset' after field calibration.

    config FUSION_PM_RH_B
        string "PM RH correction coefficient B"
        default "3.0"
        depends on FUSION_PM_RH_ENABLE
        help
            Exponent 'b' in PM RH correction formula.
            Default: 3.0 (conservative, based on literature).

    config FUSION_PM_RH_MAX_PERCENT
        int "Maximum RH for PM correction (%)"
        default 90
        range 70 95
        depends on FUSION_PM_RH_ENABLE
        help
            Above this RH, PM correction is not applied (quality flagged as low).
            Optical sensors become unreliable at very high RH.
            Default: 90%.

    config FUSION_CO2_PRESSURE_ENABLE
        bool "Enable CO2 pressure compensation"
        depends on !IAQ_S8_USE_SENSOR_PRESSURE_COMP
        default y
        help
            Compensate CO2 readings for barometric pressure changes.
            Formula: co2_corrected = co2_raw * (P_ref / P_measured).
            Useful for altitude changes and weather variations.

    config FUSION_CO2_PRESSURE_REF_PA
        int "Reference pressure for CO2 compensation (Pa)"
        default 101325
        range 95000 106000
        depends on FUSION_CO2_PRESSURE_ENABLE
        help
            Reference pressure (Pa) for CO2 compensation.
            Default: 101325 Pa (sea level standard).
            Adjust for local altitude if needed.

    config FUSION_TEMP_SELF_HEAT_OFFSET_C
        string "Temperature self-heating offset (°C)"
        default "0.0"
        help
            Offset to compensate for sensor self-heating.
            If SHT45 reads warmer than ambient due to board heat, set positive offset.
            Example: "0.5" if sensor reads 0.5°C high.
            Runtime adjustable via console 'fusion set temp_offset'.

    config FUSION_CO2_ABC_ENABLE
        bool "Enable CO2 automatic baseline correction (ABC)"
        depends on !IAQ_S8_ENABLE_ABC
        default n
        help
            Automatically track and correct CO2 sensor baseline drift.
            Assumes sensor is occasionally exposed to outdoor air (400 ppm).
            Tracks nightly minima over 7 days to establish baseline.
            WARNING: Disable if sensor is in sealed/mobile environment.

    config FUSION_CO2_ABC_NIGHT_START_HOUR
        int "ABC night start hour (24hr)"
        default 2
        range 0 6
        depends on FUSION_CO2_ABC_ENABLE
        help
            Hour to start tracking CO2 minima for ABC (24-hour format).
            Default: 2 AM (typical lowest occupancy).

    config FUSION_CO2_ABC_NIGHT_END_HOUR
        int "ABC night end hour (24hr)"
        default 6
        range 3 8
        depends on FUSION_CO2_ABC_ENABLE
        help
            Hour to end tracking CO2 minima for ABC (24-hour format).
            Default: 6 AM.

endmenu

menu "Derived Metrics"
    config METRICS_AQI_ENABLE
        bool "Calculate EPA Air Quality Index (AQI)"
        default y
        help
            Compute EPA AQI from PM2.5 and PM10 measurements.
            Uses official EPA breakpoints and piecewise linear interpolation.
            Result: 0-500 with category (Good, Moderate, Unhealthy, etc.)

    config METRICS_COMFORT_ENABLE
        bool "Calculate thermal comfort metrics"
        default y
        help
            Compute dew point, heat index, and comfort score.
            Formulas: Magnus (dew point), NOAA (heat index), custom scoring.
            Result: 0-100 comfort score with category.

    config METRICS_COMFORT_TARGET_TEMP_C
        int "Target comfort temperature (°C)"
        default 22
        range 18 26
        depends on METRICS_COMFORT_ENABLE
        help
            Ideal temperature for comfort scoring.
            Deviations reduce comfort score.
            Default: 22°C.

    config METRICS_COMFORT_TARGET_RH_PCT
        int "Target comfort relative humidity (%)"
        default 45
        range 30 60
        depends on METRICS_COMFORT_ENABLE
        help
            Ideal RH for comfort scoring.
            Deviations reduce comfort score.
            Default: 45%.

    config METRICS_PRESSURE_TREND_ENABLE
        bool "Calculate barometric pressure trend"
        default y
        help
            Track pressure changes over configurable window (default 3 hours).
            Result: RISING, STABLE, or FALLING with delta value.
            Useful for weather context and ventilation strategy.

    config METRICS_PRESSURE_TREND_WINDOW_HR
        int "Pressure trend window (hours)"
        default 3
        range 1 6
        depends on METRICS_PRESSURE_TREND_ENABLE
        help
            Time window for pressure trend calculation.
            Default: 3 hours (meteorological standard).

    config METRICS_PRESSURE_TREND_THRESHOLD_HPA
        string "Pressure trend threshold (hPa)"
        default "1.5"
        depends on METRICS_PRESSURE_TREND_ENABLE
        help
            Change threshold to classify as RISING or FALLING.
            Value represents delta over the configured window (default 3h).

    config METRICS_PRESSURE_TREND_HYSTERESIS_HPA
        string "Pressure trend hysteresis (hPa)"
        default "0.3"
        depends on METRICS_PRESSURE_TREND_ENABLE
        help
            Hysteresis band applied when exiting RISING/FALLING back to STABLE.
            Prevents rapid oscillation around the trend threshold.
            Must be <= threshold.

    config METRICS_VOC_NOX_CATEGORIES_ENABLE
        bool "Calculate VOC/NOx quality categories"
        default y
        help
            Map SGP41 VOC and NOx indices (0-500) to user-friendly categories.
            Categories: Excellent, Good, Moderate, Poor, Very Poor, Severe.
            Helps interpret gas sensor readings without understanding index scale.

    config METRICS_MOLD_RISK_ENABLE
        bool "Calculate mold risk index"
        default y
        help
            Assess mold growth risk based on humidity, dew point, and duration.
            Combines RH > 65%, dew point proximity to cold surfaces.
            Result: 0-100 risk score with category (Low, Moderate, High, Severe).
            Helps prevent costly mold remediation.

    config METRICS_MOLD_RISK_COLD_SURFACE_OFFSET_C
        int "Cold surface temperature offset (°C)"
        default 5
        range 0 15
        depends on METRICS_MOLD_RISK_ENABLE
        help
            Assume cold surfaces (walls, windows) are this many °C below ambient.
            Higher values = more conservative (higher risk scores).
            Default: 5°C (typical for poorly insulated walls).

    config METRICS_CO2_RATE_ENABLE
        bool "Calculate CO2 rate of change"
        default y
        help
            Track CO2 change rate (ppm/hour) for occupancy and ventilation detection.
            Rapid rise indicates occupancy increase or ventilation failure.
            Rapid fall indicates effective ventilation or occupants leaving.

    config METRICS_CO2_RATE_WINDOW_MIN
        int "CO2 rate calculation window (minutes)"
        default 15
        range 5 60
        depends on METRICS_CO2_RATE_ENABLE
        help
            Time window for CO2 rate-of-change calculation.
            Shorter = more responsive to changes.
            Longer = more stable, less noisy.
            Default: 15 minutes.

    config METRICS_PM_SPIKE_DETECTION_ENABLE
        bool "Detect PM2.5 pollution spikes"
        default y
        help
            Detect sudden PM2.5 increases (cooking, smoking, outdoor pollution).
            Compares current reading to recent average.
            Triggers alert flag for automation (air purifier, notification).

    config METRICS_PM_SPIKE_THRESHOLD_UGPM3
        int "PM2.5 spike threshold (µg/m³)"
        default 25
        range 10 100
        depends on METRICS_PM_SPIKE_DETECTION_ENABLE
        help
            Minimum PM2.5 increase to trigger spike detection.
            Default: 25 µg/m³ above baseline (typical cooking event).

    config METRICS_PM_SPIKE_BASELINE_WINDOW_MIN
        int "PM2.5 baseline averaging window (minutes)"
        default 30
        range 10 120
        depends on METRICS_PM_SPIKE_DETECTION_ENABLE
        help
            Time window for calculating PM2.5 baseline (pre-spike level).
            Default: 30 minutes.

endmenu

endmenu
```

## components/sensor_drivers/Kconfig.projbuild
```kconfig
menu "Sensor Hardware Configuration"

    menu "I2C Bus Configuration"

        config IAQ_I2C_SDA_GPIO
            int "I2C SDA GPIO"
            default 8
            range 0 48
            help
                GPIO number for I2C SDA (Serial Data Line).
                Shared by SHT4x (SHT45), BMP280, and SGP41 sensors.
                Default: GPIO8 (safe for ESP32-S3 DevKit).

        config IAQ_I2C_SCL_GPIO
            int "I2C SCL GPIO"
            default 9
            range 0 48
            help
                GPIO number for I2C SCL (Serial Clock Line).
                Shared by SHT4x (SHT45), BMP280, and SGP41 sensors.
                Default: GPIO9 (safe for ESP32-S3 DevKit).

        config IAQ_I2C_FREQ_HZ
            int "I2C Clock Frequency (Hz)"
            default 100000
            range 10000 400000
            help
                I2C master clock frequency in Hz.
                100kHz is safe for all sensors; 400kHz (fast mode) may work.
                Default: 100000 (standard mode).

        config IAQ_I2C_TIMEOUT_MS
            int "I2C Timeout (ms)"
            default 1000
            range 100 10000
            help
                I2C transaction timeout in milliseconds.
                Default: 1000ms.

        config IAQ_I2C_INTERNAL_PULLUPS
            bool "Enable internal pull-ups (SDA/SCL)"
            default y
            help
                Enable ESP32 internal pull-ups on the I2C SDA and SCL pins.
                Internal pulls are weak (~20–50 kΩ typ) and are not sufficient
                alone for fast edges at higher speeds or with higher bus
                capacitance. Keep enabled for dev bring-up; disable in production
                when relying on proper external pull-ups on your I2C modules/PCB.

    endmenu

    menu "BMP280 Barometer"

        config IAQ_BMP280_ADDR
            int "BMP280 I2C address (-1 = auto)"
            default -1
            range -1 119
            help
                I2C address for BMP280. Valid values are 0x76 (118) or 0x77 (119).
                Set to -1 to auto-probe 0x76 then 0x77.

        config IAQ_BMP280_OSRS_T
            int "Temperature oversampling (osrs_t code)"
            default 1
            range 0 5
            help
                BMP280 temperature oversampling setting used in ctrl_meas.
                Code mapping: 0=skip, 1=x1, 2=x2, 3=x4, 4=x8, 5=x16.
                NOTE: Using 0 (skip) may degrade pressure compensation accuracy.

        config IAQ_BMP280_OSRS_P
            int "Pressure oversampling (osrs_p code)"
            default 3
            range 0 5
            help
                BMP280 pressure oversampling setting used in ctrl_meas.
                Code mapping: 0=skip, 1=x1, 2=x2, 3=x4, 4=x8, 5=x16.

        config IAQ_BMP280_FILTER
            int "IIR filter coefficient (filter code)"
            default 2
            range 0 4
            help
                BMP280 IIR filter coefficient in config register.
                Code mapping: 0=off, 1=2, 2=4, 3=8, 4=16.

        config IAQ_BMP280_MEAS_DELAY_MARGIN_MS
            int "Measurement delay margin (ms)"
            default 3
            range 0 50
            help
                Extra delay margin added to the computed forced-mode measurement time.
                Datasheet formula: 1.25ms + 2.3ms*osrs_t + 2.3ms*osrs_p.
                A small margin (2–5ms) is recommended.

    endmenu

    menu "UART Configuration"

        menu "PMS5003 Particulate Matter Sensor"

            config IAQ_PMS5003_UART_PORT
                int "UART Port Number"
                default 1
                range 0 2
                help
                    UART port for PMS5003 sensor (0, 1, or 2).
                    Port 0 is typically used by console.
                    Default: 1.

            config IAQ_PMS5003_TX_GPIO
                int "TX GPIO"
                default 17
                range 0 48
                help
                    GPIO for UART TX to PMS5003.
                    Default: GPIO17.

            config IAQ_PMS5003_RX_GPIO
                int "RX GPIO"
                default 18
                range 0 48
                help
                    GPIO for UART RX from PMS5003.
                    Default: GPIO18.

            config IAQ_PMS5003_SET_GPIO
                int "SET Pin GPIO (Sleep/Wake Control)"
                default -1
                range -1 48
                help
                    GPIO for PMS5003 SET pin (optional).
                    -1 disables power management.
                    Default: -1 (disabled).

            config IAQ_PMS5003_RX_BUF_SIZE
                int "RX Buffer Size (bytes)"
                default 256
                range 256 2048
                help
                    UART RX buffer size for PMS5003.
                    MUST be > 128 bytes (ESP32-S3 UART FIFO size).
                    PMS5003 frame is 32 bytes; buffer should accommodate bursts.
                    Default: 256 bytes.

            config IAQ_PMS5003_RST_GPIO
                int "RESET Pin GPIO (active LOW)"
                default -1
                range -1 48
                help
                    Optional hardware RESET pin for PMS5003.
                    -1 disables hardware reset control.
                    Active LOW: driver pulses LOW then HIGH during reset.

            config IAQ_PMS5003_RST_PULSE_MS
                int "RESET pulse width (ms)"
                default 50
                range 10 500
                help
                    Duration to hold RESET pin LOW when performing a hard reset.

            config IAQ_PMS5003_RST_SETTLE_MS
                int "RESET settle delay (ms)"
                default 200
                range 50 2000
                help
                    Delay after releasing RESET (HIGH) before attempting to read.
                    Note: overall warm-up is managed by the coordinator.

            menu "Filtering and Background Reader"

                config IAQ_PMS5003_BG_READER
                    bool "Enable background UART reader"
                    default y
                    help
                        Continuously parse PMS5003 frames at ~1 Hz in the background
                        and maintain a smoothed reading. The coordinator read will
                        fetch the latest smoothed value without blocking on UART.

                config IAQ_PMS5003_RING_SIZE
                    int "Median window (samples)"
                    default 5
                    range 3 9
                    depends on IAQ_PMS5003_BG_READER
                    help
                        Number of recent samples used for median filtering
                        before EWMA smoothing. Use an odd number (3,5,7,9).

                config IAQ_PMS5003_EWMA_ALPHA
                    string "EWMA alpha (0.0-1.0)"
                    default "0.3"
                    depends on IAQ_PMS5003_BG_READER
                    help
                        Exponential moving average weight. Higher alpha reacts
                        faster to changes, lower alpha smooths more. Example: 0.3.

                config IAQ_PMS5003_STALE_MS
                    int "Stale timeout (ms)"
                    default 5000
                    range 1000 60000
                    depends on IAQ_PMS5003_BG_READER
                    help
                        If no valid frame is received within this time, the
                        next driver read reports timeout.

            endmenu

        endmenu

        menu "Senseair S8 CO2 Sensor"

            config IAQ_S8_UART_PORT
                int "UART Port Number"
                default 2
                range 0 2
                help
                    UART port for Senseair S8 sensor (0, 1, or 2).
                    Must differ from PMS5003 port if both enabled.
                    Default: 2.

            config IAQ_S8_ADDR
                int "Modbus Address"
                default 254
                range 1 254
                help
                    Senseair S8 Modbus address (decimal). Default: 254 (0xFE).
                    Change only if your module has been readdressed.

            config IAQ_S8_TX_GPIO
                int "TX GPIO"
                default 47
                range 0 48
                help
                    GPIO for UART TX to S8.
                    Default: GPIO47 (avoids conflict with USB D-/D+ on 19/20).

            config IAQ_S8_RX_GPIO
                int "RX GPIO"
                default 48
                range 0 48
                help
                    GPIO for UART RX from S8.
                    Default: GPIO48 (avoids conflict with USB D-/D+ on 19/20).

            config IAQ_S8_RX_BUF_SIZE
                int "RX Buffer Size (bytes)"
                default 256
                range 256 2048
                help
                    UART RX buffer size for S8.
                    MUST be > 128 bytes (ESP32-S3 UART FIFO size).
                    S8 Modbus responses are typically <32 bytes.
                    Default: 256 bytes.

            config IAQ_S8_ENABLE_ABC
                bool "Enable sensor-side ABC (Automatic Baseline Correction)"
                default n
                help
                    When enabled, the driver will configure the S8 to manage ABC internally
                    via its ABC period holding register. This disables fusion-side ABC.

            config IAQ_S8_ABC_PERIOD_HOURS
                int "ABC period (hours)"
                default 180
                range 0 10000
                depends on IAQ_S8_ENABLE_ABC
                help
                    ABC period in hours (0 disables ABC). Typical: 180 hours (7.5 days).

            config IAQ_S8_USE_SENSOR_PRESSURE_COMP
                bool "Use sensor-side pressure compensation (if supported)"
                default n
                help
                    If the S8 variant supports ambient pressure input via Modbus, enable this
                    to write measured pressure to the sensor. This will disable fusion-side
                    pressure compensation to avoid double-correction. If unsupported, this
                    setting has no effect.

        endmenu

    endmenu

endmenu
```

## components/web_portal/Kconfig.projbuild
```kconfig
menu "Web Portal"

config IAQ_WEB_PORTAL_ENABLE_HTTPS
    bool "Enable HTTPS for web portal"
    default y
    help
      When enabled, the portal can run over HTTPS (esp_https_server) once STA
      is connected. Cert/key are loaded from LittleFS files at /www/cert.pem and
      /www/key.pem if present; otherwise, a built-in self-signed dev cert is used.
      In AP-only provisioning mode, the portal always runs HTTP for captive portal
      compatibility.

config IAQ_WEB_PORTAL_MAX_WS_CLIENTS
    int "Maximum WebSocket clients"
    range 1 32
    default 8

config IAQ_WEB_PORTAL_CORS_ORIGIN
    string "CORS allowed origin"
    default "*"
    help
      Set to a specific origin (e.g., http://192.168.4.1) for tighter security.

config IAQ_WEB_PORTAL_STATIC_MAX_AGE_SEC
    int "Static file Cache-Control max-age (seconds)"
    range 0 86400
    default 600

config IAQ_WEB_PORTAL_WS_PING_INTERVAL_SEC
    int "WebSocket ping interval (seconds)"
    range 5 600
    default 30

config IAQ_WEB_PORTAL_WS_PONG_TIMEOUT_SEC
    int "WebSocket pong timeout (seconds)"
    range 10 1800
    default 90

config IAQ_WEB_PORTAL_WIFI_SCAN_LIMIT
    int "WiFi scan result limit"
    range 5 100
    default 20

config IAQ_WEB_PORTAL_CADENCE_MAX_MS
    int "Max allowed sensor cadence (ms)"
    range 0 7200000
    default 3600000

endmenu
```

## sdkconfig.defaults
```kconfig
# sdkconfig.defaults
# Default configuration for IAQ Monitor

# ESP32-S3 specific
CONFIG_IDF_TARGET="esp32s3"
CONFIG_ESP32S3_DEFAULT_CPU_FREQ_240=y
CONFIG_ESPTOOLPY_FLASHSIZE_8MB=y

# FreeRTOS
CONFIG_FREERTOS_HZ=100
CONFIG_FREERTOS_UNICORE=n

# WiFi
CONFIG_ESP_WIFI_STATIC_RX_BUFFER_NUM=16
CONFIG_ESP_WIFI_DYNAMIC_RX_BUFFER_NUM=32
CONFIG_ESP_WIFI_DYNAMIC_TX_BUFFER_NUM=32
CONFIG_ESP_WIFI_AMPDU_TX_ENABLED=y
CONFIG_ESP_WIFI_TX_BA_WIN=6
CONFIG_ESP_WIFI_AMPDU_RX_ENABLED=y
CONFIG_ESP_WIFI_RX_BA_WIN=6
CONFIG_ESP_WIFI_TASK_PINNED_TO_CORE_1=y

# LWIP
CONFIG_LWIP_LOCAL_HOSTNAME="iaq-monitor"
CONFIG_LWIP_MAX_SOCKETS=10
CONFIG_LWIP_TCPIP_TASK_AFFINITY_CPU1=y

# HTTP Server (portal)
# Modern browsers send long Sec-CH-UA and related headers.
# Increase request header limit to avoid 431 errors.
CONFIG_HTTPD_MAX_REQ_HDR_LEN=2048
CONFIG_HTTPD_WS_SUPPORT=y

# MQTT
CONFIG_MQTT_PROTOCOL_311=y
CONFIG_MQTT_PROTOCOL_5=y
CONFIG_MQTT_TRANSPORT_SSL=y
CONFIG_MQTT_TRANSPORT_WEBSOCKET=n
CONFIG_MQTT_USE_CUSTOM_CONFIG=n
CONFIG_MQTT_TASK_CORE_SELECTION_ENABLED=y
CONFIG_MQTT_USE_CORE_1=y

# TLS certificate bundle (for mqtts public CAs)
CONFIG_MBEDTLS_CERTIFICATE_BUNDLE=y
# Use the smaller "common" selection instead of full bundle
CONFIG_MBEDTLS_CERTIFICATE_BUNDLE_DEFAULT_CMN=y
CONFIG_FREERTOS_RUN_TIME_STATS_USING_ESP_TIMER=y

# HTTPS server memory tuning
# Reduce TLS record buffer sizes to shrink per-connection heap usage
CONFIG_MBEDTLS_SSL_IN_CONTENT_LEN=4096
CONFIG_MBEDTLS_SSL_OUT_CONTENT_LEN=4096
# Allow mbedTLS to shrink buffers after handshake
CONFIG_MBEDTLS_DYNAMIC_BUFFER=y
CONFIG_MBEDTLS_SSL_VARIABLE_BUFFER_LENGTH=y

# MQTT QoS Levels
CONFIG_IAQ_MQTT_CRITICAL_QOS=1
CONFIG_IAQ_MQTT_TELEMETRY_QOS=0

# Logging
CONFIG_LOG_DEFAULT_LEVEL_INFO=y
# Compile out DEBUG/VERBOSE to reduce size and overhead
CONFIG_LOG_MAXIMUM_LEVEL_INFO=y
CONFIG_LOG_COLORS=y
CONFIG_LOG_TIMESTAMP_SOURCE_RTOS=y

# Partition Table
CONFIG_PARTITION_TABLE_CUSTOM=y
CONFIG_PARTITION_TABLE_CUSTOM_FILENAME="partitions.csv"
CONFIG_PARTITION_TABLE_FILENAME="partitions.csv"

# Enable filesystem support (for future web server)
CONFIG_FATFS_LFN_HEAP=y
CONFIG_FATFS_MAX_LFN=255


# NVS
CONFIG_NVS_ENCRYPTION=n  # Enable later for production

# Console (for runtime commands)
# Set the primary console to the on‑chip USB‑Serial/JTAG (CDC ACM on /dev/ttyACM*)
CONFIG_ESP_CONSOLE_UART_DEFAULT=n
CONFIG_ESP_CONSOLE_USB_SERIAL_JTAG=y
CONFIG_ESP_CONSOLE_USB_CDC=n
CONFIG_ESP_CONSOLE_UART_BAUDRATE=115200
# Do not mirror logs to a secondary console
CONFIG_ESP_CONSOLE_SECONDARY_NONE=y

# Power Management (disabled for now)
CONFIG_PM_ENABLE=n

# Watchdog
CONFIG_ESP_TASK_WDT=y
CONFIG_ESP_TASK_WDT_TIMEOUT_S=30
CONFIG_ESP_TASK_WDT_CHECK_IDLE_TASK_CPU0=y
CONFIG_ESP_TASK_WDT_CHECK_IDLE_TASK_CPU1=y

# Core dump
CONFIG_ESP_COREDUMP_ENABLE_TO_NONE=y

# Optimization
# Prefer -O2 (performance) instead of debug
CONFIG_COMPILER_OPTIMIZATION_PERF=y
# Keep assertions enabled (maps to -DNDEBUG off)
CONFIG_COMPILER_OPTIMIZATION_ASSERTIONS_ENABLE=y
```
